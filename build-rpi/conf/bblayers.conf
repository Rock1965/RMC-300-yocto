## build-rpi/conf/bblayers.conf
```bitbake
# LAYER_CONF_VERSION is increased each time build/conf/bblayers.conf
# changes incompatibly
LCONF_VERSION = "6"

BBPATH = "${TOPDIR}"
BBFILES ?= ""

BBLAYERS ?= " \
  /home/jessieho/raspberry/rmc-300-yocto/yocto-base/meta-kongja-rpi \
  /home/jessieho/raspberry/rmc-300-yocto/yocto-base/meta-raspberrypi-fido \
  /home/jessieho/raspberry/rmc-300-yocto/yocto-base/meta-qt5-fido \
  /home/jessieho/raspberry/rmc-300-yocto/yocto-base/poky-fido/meta \
  /home/jessieho/raspberry/rmc-300-yocto/yocto-base/poky-fido/meta-yocto \
  /home/jessieho/raspberry/rmc-300-yocto/yocto-base/meta-openembedded-fido/meta-oe \
  /home/jessieho/raspberry/rmc-300-yocto/yocto-base/meta-openembedded-fido/meta-networking \
  /home/jessieho/raspberry/rmc-300-yocto/yocto-base/meta-openembedded-fido/meta-python \
  /home/jessieho/raspberry/rmc-300-yocto/yocto-base/meta-openembedded-fido/meta-ruby \
  /home/jessieho/raspberry/rmc-300-yocto/yocto-base/meta-openembedded-fido/meta-multimedia \
  "
BBLAYERS_NON_REMOVABLE ?= " \
  /home/jessieho/raspberry/rmc-300-yocto/yocto-base/poky-fido/meta \
  /home/jessieho/raspberry/rmc-300-yocto/yocto-base/poky-fido/meta-yocto \
  "
```

## build-rpi2/conf/bblayers.conf
```bitbake
# LAYER_CONF_VERSION is increased each time build/conf/bblayers.conf
# changes incompatibly
LCONF_VERSION = "6"

BBPATH = "${TOPDIR}"
BSPDIR := "${@os.path.abspath(os.path.dirname(d.getVar('FILE', True)))+'/../..'}"
BBFILES ?= ""

BBLAYERS ?= " \
  ${BSPDIR}/yocto-base/meta-kongja-rpi \
  ${BSPDIR}/yocto-base/meta-raspberrypi-fido \
  ${BSPDIR}/yocto-base/meta-qt5-fido \
  ${BSPDIR}/yocto-base/poky-fido/meta \
  ${BSPDIR}/yocto-base/poky-fido/meta-yocto \
  ${BSPDIR}/yocto-base/meta-openembedded-fido/meta-oe \
  ${BSPDIR}/yocto-base/meta-openembedded-fido/meta-networking \
  ${BSPDIR}/yocto-base/meta-openembedded-fido/meta-python \
  ${BSPDIR}/yocto-base/meta-openembedded-fido/meta-ruby \
  ${BSPDIR}/yocto-base/meta-openembedded-fido/meta-multimedia \
  "
BBLAYERS_NON_REMOVABLE ?= " \
  /home/jessieho/hdd500gb/raspberry/rmc-300-yocto/yocto-base/poky-fido/meta \
  /home/jessieho/hdd500gb/raspberry/rmc-300-yocto/yocto-base/poky-fido/meta-yocto \
  "
```
